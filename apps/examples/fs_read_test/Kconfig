## apps/examples/fs_read_test/Kconfig
```kconfig
#
# For a description of the syntax of this configuration file,
# see kconfig-language at https://www.kernel.org/doc/Documentation/kbuild/kconfig-language.txt
#

config EXAMPLES_FS_READ
	bool "\"FS Read Test\" example"
	default n
	---help---
		Enable the \"FS Read Example\" example

if EXAMPLES_FS_READ

# config EXAMPLES_FS_READ_PROGNAME
#	string "Program name"
#	default "tls_client"
#	depends on BUILD_KERNEL

menu option
config EXAMPLES_FS_READ_VALIDATE
	bool "Validate Reads"
	default n
	depends on EXAMPLES_FS_READ
endmenu

endif # EXAMPLES_FS_READ

config USER_ENTRYPOINT
	string
	default "fs_read_main" if ENTRY_FS_READ
```

## apps/examples/fs_scan_test/Kconfig
```kconfig
#
# For a description of the syntax of this configuration file,
# see kconfig-language at https://www.kernel.org/doc/Documentation/kbuild/kconfig-language.txt
#

config EXAMPLES_SCAN_TEST
	bool "\"FS SCAN TEST\" example"
	default n
	---help---
		Enable the \"FS SCAN TEST\" example

config USER_ENTRYPOINT
	string
	default "fs_scan_main" if ENTRY_SCAN_TEST
```

## apps/examples/fs_write_test/Kconfig
```kconfig
#
# For a description of the syntax of this configuration file,
# see kconfig-language at https://www.kernel.org/doc/Documentation/kbuild/kconfig-language.txt
#

config EXAMPLES_FS_WRITE
	bool "\"FS Write Test\" example"
	default n
	---help---
		Enable the \"FS Write Example\" example

if EXAMPLES_FS_WRITE

# config EXAMPLES_FS_WRITE_PROGNAME
#	string "Program name"
#	default "tls_client"
#	depends on BUILD_KERNEL

menu option
config EXAMPLES_FS_WRITE_VALIDATE
	bool "Validate Writes"
	default n
	depends on EXAMPLES_FS_WRITE
endmenu

endif # EXAMPLES_FS_WRITE

config USER_ENTRYPOINT
	string
	default "fs_write_main" if ENTRY_FS_WRITE
```

## apps/examples/trap_test/Kconfig
```kconfig
#
# For a description of the syntax of this configuration file,
# see kconfig-language at https://www.kernel.org/doc/Documentation/kbuild/kconfig-language.txt
#

config EXAMPLES_TRAP
	bool "\"Trap, Test\" example"
	default n
	---help---
		Enable the \"Trap, Test\" example

config USER_ENTRYPOINT
	string
	default "trap_main" if ENTRY_TRAP
```

## apps/system/pm_metrics/Kconfig
```kconfig
#
# For a description of the syntax of this configuration file,
# see kconfig-language at https://www.kernel.org/doc/Documentation/kbuild/kconfig-language.txt
#

config SYSTEM_PM_METRICS
	bool "PM Metrics Tool"
	default n
	depends on PM_METRICS
	---help---
		Monitor PM suspend and sleep to display PM Metrics.
```
